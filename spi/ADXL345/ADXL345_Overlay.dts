/dts-v1/;
/plugin/;

/{
    compatible = "brcm,bcm2711";

    fragment@1 {
        target = <&spi0>;
        __overlay__ {
            #address-cells = <1>;
            #size-cells = <0>;
            status = "okay";

            ADXL345: adxl345@0 {
                compatible = "decryptec,ADXL345_spi";  // Match driver's of_match_table
                reg = <0>;                  // SPI CE0 (Chip Enable 0)
		spi-max-frequency = <5000000>;      // 5 MHz
		int1-gpio = <&gpio 1 0>;
            };
        };
    };

  fragment@2 {
        target = <&spidev0>;
        __overlay__ {
            status = "disabled";  // Disable the default spidev driver
        }; 
    }; 
};
