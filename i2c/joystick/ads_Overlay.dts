/dts-v1/;
/plugin/;
/{
	compatible = "brcm, bcm2835";
	fragment@0{
		target = <&i2c1>;
		__overlay__{
			#address-cells = <1>;
			#size-cells = <0>;
			
			my_ads: my_ads@48{
				compatible = "decryptec,my_ads";
				reg = <0x48>;
				status = "okay";
			};
		};
	};
};
